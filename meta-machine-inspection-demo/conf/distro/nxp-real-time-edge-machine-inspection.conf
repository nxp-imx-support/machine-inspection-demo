## meta-machine-inspection-demo/conf/distro/nxp-real-time-edge-machine-inspection.conf
```bitbake
require conf/distro/include/nxp-real-time-edge-machine-inspection-env.inc

DISTRO = "nxp-real-time-edge-machine-inspection"
```

## meta-machine-inspection-demo/conf/layer.conf
```bitbake
# We have a conf and classes directory, add to BBPATH
BBPATH .= ":${LAYERDIR}"

# We have a packages directory, add to BBFILES
BBFILES += "${LAYERDIR}/recipes-*/*/*.bb \
            ${LAYERDIR}/recipes-*/*/*.bbappend"

BBFILE_COLLECTIONS += "meta-machine-inspection-demo"
BBFILE_PATTERN_meta-machine-inspection-demo := "^${LAYERDIR}/"
BBFILE_PRIORITY_meta-machine-inspection-demo = "9"
LAYERSERIES_COMPAT_meta-machine-inspection-demo = "mickledore"
```
